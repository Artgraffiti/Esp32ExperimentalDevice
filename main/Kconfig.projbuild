## main/Kconfig.projbuild
```kconfig
menu "Application Configuration"
		
	config GPIO_RANGE_MAX
		int
		default 33 if IDF_TARGET_ESP32
		default 46 if IDF_TARGET_ESP32S2
		default 48 if IDF_TARGET_ESP32S3
		default 18 if IDF_TARGET_ESP32C2
		default 19 if IDF_TARGET_ESP32C3
		default 30 if IDF_TARGET_ESP32C6
		default 54 if IDF_TARGET_ESP32P4

	config BUTTON_LEFT_GPIO
		int "BUTTON LEFT GPIO number"
		range 0 GPIO_RANGE_MAX
		default 4 if IDF_TARGET_ESP32C3
		help
			BUTTON GPIO number (IOxx).

	config BUTTON_DOWN_GPIO
		int "BUTTON DOWN GPIO number"
		range 0 GPIO_RANGE_MAX
		default 5 if IDF_TARGET_ESP32C3
		help
			BUTTON GPIO number (IOxx).

	config BUTTON_UP_GPIO
		int "BUTTON UP GPIO number"
		range 0 GPIO_RANGE_MAX
		default 6 if IDF_TARGET_ESP32C3
		help
			BUTTON GPIO number (IOxx).

	config BUTTON_RIGHT_GPIO
		int "BUTTON RIGHT GPIO number"
		range 0 GPIO_RANGE_MAX
		default 7 if IDF_TARGET_ESP32C3
		help
			BUTTON GPIO number (IOxx).
	
	config BUTTON_CONFIRM_GPIO
		int "BUTTON CONFIRM GPIO number"
		range 0 GPIO_RANGE_MAX
		default 8 if IDF_TARGET_ESP32C3
		help
			BUTTON GPIO number (IOxx).

	config BUTTON_CANCEL_GPIO
		int "BUTTON CANCEL GPIO number"
		range 0 GPIO_RANGE_MAX
		default 9 if IDF_TARGET_ESP32C3
		help
			BUTTON GPIO number (IOxx).
endmenu
```
